## boards/shields/dongle_display-091-oled/Kconfig.shield
```kconfig
# Copyright (c) 2024 The ZMK Contributors
# SPDX-License-Identifier: MIT

config SHIELD_DONGLE_DISPLAY_091_OLED
	def_bool $(shields_list_contains,dongle_display_091_oled)
```

## config/west.yml
```yaml
manifest:
  remotes:
    - name: zmkfirmware
      url-base: https://github.com/zmkfirmware
    - name: garrettfaucher
      url-base: https://github.com/garrettfaucher
  projects:
    - name: zmk
      remote: zmkfirmware
      revision: main
      import: app/west.yml
    - name: zmk-config
      remote: garrettfaucher
      revision: master
  self:
    path: config
```
